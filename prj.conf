## CMakeLists.txt
```
# CMakeLists.txt for Zephyr port of WB09_Blinky iBeacon
cmake_minimum_required(VERSION 3.20.0)

find_package(Zephyr REQUIRED HINTS $ENV{ZEPHYR_BASE})
project(wb09_ibeacon)

target_sources(app PRIVATE src/main.c src/hog.c)
```

## prj.conf
```kconfig
# prj.conf for HID Volume Control (nRF52840 DK)
CONFIG_BT=y
CONFIG_BT_PERIPHERAL=y
CONFIG_BT_DEVICE_NAME="nRF52840 Remote"
CONFIG_BT_DEVICE_APPEARANCE=961
CONFIG_BT_MAX_PAIRED=5
CONFIG_BT_MAX_CONN=1

# Services
CONFIG_BT_DIS=y
CONFIG_BT_DIS_PNP=y
CONFIG_BT_DIS_MODEL="nRF52840-Remote"
CONFIG_BT_DIS_MANUF="Nordic"
CONFIG_BT_BAS=y

# Security (PIN Entry)
CONFIG_BT_SETTINGS=y
CONFIG_SETTINGS=y
CONFIG_FLASH=y
CONFIG_FLASH_MAP=y
CONFIG_NVS=y
CONFIG_BT_SMP=y
CONFIG_BT_BONDABLE=y
CONFIG_BT_FIXED_PASSKEY=n

# Enable Secure Connections (nRF52840 handles this well)
# CONFIG_BT_SMP_SC_ENABLED=y
# CONFIG_BT_TINYCRYPT_ECC=y

# Disable Service Changed indication
CONFIG_BT_GATT_SERVICE_CHANGED=n

# Large stacks for stability
CONFIG_SYSTEM_WORKQUEUE_STACK_SIZE=4096
CONFIG_BT_RX_STACK_SIZE=4096
CONFIG_BT_HCI_TX_STACK_SIZE=2048

# GPIO and Logging (Preserved as requested)
CONFIG_GPIO=y
CONFIG_LOG=y
CONFIG_BT_LOG_LEVEL_INF=y
CONFIG_BT_SMP_LOG_LEVEL_DBG=y
CONFIG_BT_L2CAP_LOG_LEVEL_DBG=y
CONFIG_BT_ATT_LOG_LEVEL_DBG=y
CONFIG_BT_GATT_LOG_LEVEL_DBG=y
CONFIG_SERIAL=y
CONFIG_UART_CONSOLE=y
CONFIG_STDOUT_CONSOLE=y
CONFIG_PRINTK=y
```

## src/main.c
```c
/* src/main.c: HID Consumer Control (Just Works / Pairing Mode) */
#include <zephyr/kernel.h>
#include <zephyr/bluetooth/bluetooth.h>
#include <zephyr/bluetooth/hci.h>
#include <zephyr/bluetooth/conn.h>
#include <zephyr/bluetooth/uuid.h>
#include <zephyr/bluetooth/gatt.h>
#include <zephyr/bluetooth/services/bas.h>
#include <zephyr/bluetooth/services/dis.h>
#include <zephyr/drivers/gpio.h>
#include <zephyr/logging/log.h>
#include <zephyr/settings/settings.h>

#include "hog.h"

LOG_MODULE_REGISTER(main, LOG_LEVEL_INF);

/* GPIO for Buttons & LED using standard aliases */
static const struct gpio_dt_spec sw1 = GPIO_DT_SPEC_GET(DT_ALIAS(sw0), gpios);
static const struct gpio_dt_spec sw2 = GPIO_DT_SPEC_GET(DT_ALIAS(sw1), gpios);
static const struct gpio_dt_spec sw3 = GPIO_DT_SPEC_GET(DT_ALIAS(sw2), gpios);
static const struct gpio_dt_spec sw4 = GPIO_DT_SPEC_GET(DT_ALIAS(sw3), gpios);
static const struct gpio_dt_spec led = GPIO_DT_SPEC_GET(DT_ALIAS(led0), gpios);

static struct gpio_callback sw1_cb_data;
static struct gpio_callback sw2_cb_data;
static struct gpio_callback sw3_cb_data;
static struct gpio_callback sw4_cb_data;

/* Timing constants */
#define PAIRING_MODE_DURATION K_MINUTES(2)
#define LONG_PRESS_THRESHOLD K_SECONDS(3)
#define BLINK_INTERVAL K_MSEC(300)
#define DEBOUNCE_INTERVAL 50 /* ms */

/* Consumer Control Usage IDs - Matched to report_map in hog.c */
#define CONSUMER_VOL_UP     BIT(0)
#define CONSUMER_VOL_DOWN   BIT(1)
#define CONSUMER_PLAY_PAUSE BIT(2)
#define CONSUMER_SCAN_NEXT  BIT(3)
#define CONSUMER_SCAN_PREV  BIT(4)

static struct bt_conn *current_conn;
static uint8_t pending_report;
static bool is_pairing_mode = false;
static int64_t sw1_press_time;
static int64_t sw2_last_time;
static int64_t sw3_last_time;
static int64_t sw4_last_time;

/* Work items */
struct k_work report_work;
struct k_work unpair_work;
struct k_work_delayable pairing_timeout_work;
struct k_work_delayable blink_work;
struct k_work_delayable led_success_work;

/* Advertising Data */
static const struct bt_data ad[] = {
	BT_DATA_BYTES(BT_DATA_FLAGS, (BT_LE_AD_GENERAL | BT_LE_AD_NO_BREDR)),
	BT_DATA_BYTES(BT_DATA_UUID16_ALL,
		      BT_UUID_16_ENCODE(BT_UUID_HIDS_VAL),
		      BT_UUID_16_ENCODE(BT_UUID_BAS_VAL)),
};

static const struct bt_data sd[] = {
	BT_DATA(BT_DATA_NAME_COMPLETE, CONFIG_BT_DEVICE_NAME, sizeof(CONFIG_BT_DEVICE_NAME) - 1),
};

/* LED Blinking & Success indication */
static void blink_work_handler(struct k_work *work)
{
	if (!is_pairing_mode) {
		gpio_pin_set_dt(&led, 0);
		return;
	}

	gpio_pin_toggle_dt(&led);
	k_work_schedule(&blink_work, BLINK_INTERVAL);
}

static void led_success_handler(struct k_work *work)
{
	gpio_pin_set_dt(&led, 1);
	k_sleep(K_MSEC(1000));
	gpio_pin_set_dt(&led, 0);
}

/* Unpair and start pairing mode */
static void unpair_handler(struct k_work *work)
{
	LOG_INF("Long press detected: Clearing all bonds and entering pairing mode...");
	
	bt_le_adv_stop();

	if (current_conn) {
		bt_conn_disconnect(current_conn, BT_HCI_ERR_REMOTE_USER_TERM_CONN);
		k_sleep(K_MSEC(500));
	}

	/* Clear all existing bonds */
	bt_unpair(BT_ID_DEFAULT, NULL);

	/* Enable bonding for new devices */
	bt_set_bondable(true);

	/* Start fast advertising */
	int err = bt_le_adv_start(BT_LE_ADV_CONN_FAST_1, ad, ARRAY_SIZE(ad), sd, ARRAY_SIZE(sd));
	if (err) {
		LOG_ERR("Advertising failed to start (err %d)", err);
		return;
	}

	is_pairing_mode = true;
	k_work_schedule(&blink_work, K_NO_WAIT);
	k_work_schedule(&pairing_timeout_work, PAIRING_MODE_DURATION);
}

static void stop_pairing_mode(struct k_work *work)
{
	if (!is_pairing_mode) {
		return;
	}

	LOG_INF("Pairing Mode Timed Out.");
	is_pairing_mode = false;
	bt_set_bondable(false);
	
	if (!current_conn) {
		bt_le_adv_stop();
	}
	
	gpio_pin_set_dt(&led, 0);
}

/* Report work */
static void report_work_handler(struct k_work *work)
{
	if (!current_conn) {
		return;
	}

	uint8_t report = pending_report;
	LOG_INF("Sending HID Report: 0x%02x", report);
	
	hog_send_report(current_conn, report);
	k_sleep(K_MSEC(20));
	hog_send_report(current_conn, 0);
}

/* Button Handler */
void button_pressed(const struct device *dev, struct gpio_callback *cb, uint32_t pins)
{
	int64_t now = k_uptime_get();

	if (pins & BIT(sw1.pin)) {
		bool pressed = gpio_pin_get_dt(&sw1) > 0;
		if (pressed) {
			sw1_press_time = now;
		} else {
			/* Released */
			int64_t duration = now - sw1_press_time;
			if (duration >= k_ticks_to_ms_near64(LONG_PRESS_THRESHOLD.ticks)) {
				k_work_submit(&unpair_work);
				return;
			}
			
			/* Normal SW1 action (Vol Up) with debounce check */
			static int64_t sw1_last_release;
			if (now - sw1_last_release < DEBOUNCE_INTERVAL) return;
			sw1_last_release = now;

			if (current_conn) {
				pending_report = CONSUMER_VOL_UP;
				k_work_submit(&report_work);
			}
		}
	} else if (pins & BIT(sw2.pin)) {
		/* Debounce Vol Down */
		if (now - sw2_last_time < DEBOUNCE_INTERVAL) return;
		sw2_last_time = now;

		if (current_conn) {
			pending_report = CONSUMER_VOL_DOWN;
			k_work_submit(&report_work);
		}
	} else if (pins & BIT(sw3.pin)) {
		/* Debounce Play/Pause */
		if (now - sw3_last_time < DEBOUNCE_INTERVAL) return;
		sw3_last_time = now;

		if (current_conn) {
			pending_report = CONSUMER_PLAY_PAUSE;
			k_work_submit(&report_work);
		}
	} else if (pins & BIT(sw4.pin)) {
		/* Debounce Prev Song */
		if (now - sw4_last_time < DEBOUNCE_INTERVAL) return;
		sw4_last_time = now;

		if (current_conn) {
			pending_report = CONSUMER_SCAN_PREV;
			k_work_submit(&report_work);
		}
	}
}

/* Bluetooth Connection Management */
static void connected(struct bt_conn *conn, uint8_t err)
{
	char addr[BT_ADDR_LE_STR_LEN];
	bt_addr_le_to_str(bt_conn_get_dst(conn), addr, sizeof(addr));

	if (err) {
		LOG_ERR("Connection to %s failed (err %u)", addr, err);
		return;
	}

	LOG_INF("Connected to %s", addr);
	current_conn = bt_conn_ref(conn);

	/* Stop pairing mode on successful connection */
	if (is_pairing_mode) {
		is_pairing_mode = false;
		k_work_cancel_delayable(&pairing_timeout_work);
		k_work_cancel_delayable(&blink_work);
		k_work_schedule(&led_success_work, K_NO_WAIT);
	}
}

static void disconnected(struct bt_conn *conn, uint8_t reason)
{
	char addr[BT_ADDR_LE_STR_LEN];
	bt_addr_le_to_str(bt_conn_get_dst(conn), addr, sizeof(addr));

	LOG_INF("Disconnected from %s (reason %u)", addr, reason);
	if (current_conn) {
		bt_conn_unref(current_conn);
		current_conn = NULL;
	}
	
	if (!is_pairing_mode) {
		bt_le_adv_stop();
	}
}

static void security_changed(struct bt_conn *conn, bt_security_t level, enum bt_security_err err)
{
	if (!err) {
		LOG_INF("Security level changed: level %u", level);
		if (level >= BT_SECURITY_L2) {
			k_work_schedule(&led_success_work, K_NO_WAIT);
		}
	} else {
		LOG_ERR("Security failed: level %u err %d", level, err);
	}
}

BT_CONN_CB_DEFINE(conn_callbacks) = {
	.connected = connected,
	.disconnected = disconnected,
	.security_changed = security_changed,
};

static void pairing_complete(struct bt_conn *conn, bool bonded)
{
	LOG_INF("Pairing complete, bonded: %s", bonded ? "yes" : "no");
}

static void pairing_failed(struct bt_conn *conn, enum bt_security_err reason)
{
	LOG_ERR("Pairing failed (reason %d)", reason);
}

static struct bt_conn_auth_info_cb auth_cb_info = {
	.pairing_complete = pairing_complete,
	.pairing_failed = pairing_failed,
};

static void bt_ready(int err)
{
	if (err) {
		LOG_ERR("Bluetooth init failed (err %d)", err);
		return;
	}

	LOG_INF("Bluetooth initialized");

	hog_init();

	if (IS_ENABLED(CONFIG_BT_SETTINGS)) {
		settings_load();
	}

	/* Disable bonding by default, only enable during pairing mode */
	bt_set_bondable(false);

	/* Start non-bondable advertising to allow reconnections from existing bonds */
	err = bt_le_adv_start(BT_LE_ADV_CONN_FAST_1, ad, ARRAY_SIZE(ad), sd, ARRAY_SIZE(sd));
	if (err) {
		LOG_ERR("Initial advertising failed (err %d)", err);
	} else {
		LOG_INF("Advertising for reconnection started");
	}
}

int main(void)
{
	LOG_INF("Starting HID Remote Control with Pairing Mode...");

	k_work_init(&report_work, report_work_handler);
	k_work_init(&unpair_work, unpair_handler);
	k_work_init_delayable(&pairing_timeout_work, stop_pairing_mode);
	k_work_init_delayable(&blink_work, blink_work_handler);
	k_work_init_delayable(&led_success_work, led_success_handler);

	/* Init Buttons & LED */
	gpio_pin_configure_dt(&led, GPIO_OUTPUT_INACTIVE);
	gpio_pin_configure_dt(&sw1, GPIO_INPUT | GPIO_PULL_UP);
	gpio_pin_configure_dt(&sw2, GPIO_INPUT | GPIO_PULL_UP);
	gpio_pin_configure_dt(&sw3, GPIO_INPUT | GPIO_PULL_UP);
	gpio_pin_configure_dt(&sw4, GPIO_INPUT | GPIO_PULL_UP);

	gpio_pin_interrupt_configure_dt(&sw1, GPIO_INT_EDGE_BOTH);
	gpio_pin_interrupt_configure_dt(&sw2, GPIO_INT_EDGE_TO_ACTIVE);
	gpio_pin_interrupt_configure_dt(&sw3, GPIO_INT_EDGE_TO_ACTIVE);
	gpio_pin_interrupt_configure_dt(&sw4, GPIO_INT_EDGE_TO_ACTIVE);

	gpio_init_callback(&sw1_cb_data, button_pressed, BIT(sw1.pin));
	gpio_init_callback(&sw2_cb_data, button_pressed, BIT(sw2.pin));
	gpio_init_callback(&sw3_cb_data, button_pressed, BIT(sw3.pin));
	gpio_init_callback(&sw4_cb_data, button_pressed, BIT(sw4.pin));

	gpio_add_callback(sw1.port, &sw1_cb_data);
	gpio_add_callback(sw2.port, &sw2_cb_data);
	gpio_add_callback(sw3.port, &sw3_cb_data);
	gpio_add_callback(sw4.port, &sw4_cb_data);

	if (IS_ENABLED(CONFIG_SETTINGS)) {
		settings_subsys_init();
	}

	/* Register info callback but NO auth callback (forces Just Works) */
	bt_conn_auth_info_cb_register(&auth_cb_info);
	
	bt_enable(bt_ready);

	return 0;
}
```

## src/hog.c
```c
/** @file
 *  @brief HoG Service (Consumer Control)
 */

#include <zephyr/types.h>
#include <stddef.h>
#include <string.h>
#include <errno.h>
#include <zephyr/sys/printk.h>
#include <zephyr/sys/byteorder.h>
#include <zephyr/kernel.h>

#include <zephyr/bluetooth/bluetooth.h>
#include <zephyr/bluetooth/hci.h>
#include <zephyr/bluetooth/conn.h>
#include <zephyr/bluetooth/uuid.h>
#include <zephyr/bluetooth/gatt.h>

#include "hog.h"

enum {
	HIDS_REMOTE_WAKE = BIT(0),
	HIDS_NORMALLY_CONNECTABLE = BIT(1),
};

struct hids_info {
	uint16_t version; /* version number of base USB HID Specification */
	uint8_t code; /* country HID Device hardware is localized for. */
	uint8_t flags;
} __packed;

struct hids_report {
	uint8_t id; /* report id */
	uint8_t type; /* report type */
} __packed;

static struct hids_info info = {
	.version = 0x0111,
	.code = 0x00,
	.flags = HIDS_NORMALLY_CONNECTABLE,
};

enum {
	HIDS_INPUT = 0x01,
	HIDS_OUTPUT = 0x02,
	HIDS_FEATURE = 0x03,
};

static struct hids_report input_report = {
	.id = 0x01,
	.type = HIDS_INPUT,
};

static uint8_t report_val;
static uint8_t ctrl_point;

/* Consumer Control Report Map */
static const uint8_t report_map[] = {
	0x05, 0x0c, /* Usage Page (Consumer Devices) */
	0x09, 0x01, /* Usage (Consumer Control) */
	0xa1, 0x01, /* Collection (Application) */
	0x85, 0x01, /* Report ID (1) */
	0x15, 0x00, /* Logical Minimum (0) */
	0x25, 0x01, /* Logical Maximum (1) */
	0x75, 0x01, /* Report Size (1) */
	0x95, 0x05, /* Report Count (5) */
	0x09, 0xe9, /* Usage (Volume Up) */
	0x09, 0xea, /* Usage (Volume Down) */
	0x09, 0xcd, /* Usage (Play/Pause) */
	0x09, 0xb5, /* Usage (Scan Next Track) */
	0x09, 0xb6, /* Usage (Scan Previous Track) */
	0x81, 0x02, /* Input (Data, Variable, Absolute) */
	0x95, 0x03, /* Report Count (3) - Padding */
	0x81, 0x01, /* Input (Constant) */
	0xc0        /* End Collection */
};

static ssize_t read_info(struct bt_conn *conn,
			  const struct bt_gatt_attr *attr, void *buf,
			  uint16_t len, uint16_t offset)
{
	return bt_gatt_attr_read(conn, attr, buf, len, offset, attr->user_data,
				 sizeof(struct hids_info));
}

static ssize_t read_report_map(struct bt_conn *conn,
				const struct bt_gatt_attr *attr, void *buf,
				uint16_t len, uint16_t offset)
{
	return bt_gatt_attr_read(conn, attr, buf, len, offset, report_map,
				 sizeof(report_map));
}

static ssize_t read_report(struct bt_conn *conn,
			    const struct bt_gatt_attr *attr, void *buf,
			    uint16_t len, uint16_t offset)
{
	return bt_gatt_attr_read(conn, attr, buf, len, offset, attr->user_data,
				 sizeof(uint8_t));
}

static void input_report_ccc_changed(const struct bt_gatt_attr *attr, uint16_t value)
{
	printk("Notifications %sabled\n", value == BT_GATT_CCC_NOTIFY ? "en" : "dis");
}

static ssize_t read_report_ref(struct bt_conn *conn,
				const struct bt_gatt_attr *attr, void *buf,
				uint16_t len, uint16_t offset)
{
	return bt_gatt_attr_read(conn, attr, buf, len, offset, attr->user_data,
				 sizeof(struct hids_report));
}

static ssize_t write_ctrl_point(struct bt_conn *conn,
				 const struct bt_gatt_attr *attr,
				 const void *buf, uint16_t len, uint16_t offset,
				 uint8_t flags)
{
	uint8_t *value = attr->user_data;

	if (offset + len > sizeof(uint8_t)) {
		return BT_GATT_ERR(BT_ATT_ERR_INVALID_OFFSET);
	}

	memcpy(value + offset, buf, len);

	return len;
}

/* HID Service Declaration */
BT_GATT_SERVICE_DEFINE(hog_svc,
	BT_GATT_PRIMARY_SERVICE(BT_UUID_HIDS),
	BT_GATT_CHARACTERISTIC(BT_UUID_HIDS_INFO, BT_GATT_CHRC_READ,
			       BT_GATT_PERM_READ, read_info, NULL, &info),
	BT_GATT_CHARACTERISTIC(BT_UUID_HIDS_REPORT_MAP, BT_GATT_CHRC_READ,
			       BT_GATT_PERM_READ, read_report_map, NULL, NULL),
	BT_GATT_CHARACTERISTIC(BT_UUID_HIDS_REPORT,
			       BT_GATT_CHRC_READ | BT_GATT_CHRC_NOTIFY,
			       BT_GATT_PERM_READ_ENCRYPT,
			       read_report, NULL, &report_val),
	BT_GATT_CCC(input_report_ccc_changed,
		    BT_GATT_PERM_READ | BT_GATT_PERM_WRITE_ENCRYPT),

	BT_GATT_DESCRIPTOR(BT_UUID_HIDS_REPORT_REF, BT_GATT_PERM_READ,
			   read_report_ref, NULL, &input_report),
	BT_GATT_CHARACTERISTIC(BT_UUID_HIDS_CTRL_POINT,
			       BT_GATT_CHRC_WRITE_WITHOUT_RESP,
			       BT_GATT_PERM_WRITE, NULL, write_ctrl_point,
			       &ctrl_point),
);

void hog_init(void)
{
}

/* We use attribute index 6 (the value characteristic of the Report) for notifications */
void hog_send_report(struct bt_conn *conn, uint8_t report)
{
	bt_gatt_notify(conn, &hog_svc.attrs[6], &report, sizeof(report));
	k_sleep(K_MSEC(20));
	report = 0;
	bt_gatt_notify(conn, &hog_svc.attrs[6], &report, sizeof(report));
}
```

## src/hog.h
```c
/** @file
 *  @brief HoG Service sample
 */

#ifdef __cplusplus
extern "C" {
#endif

struct bt_conn;

void hog_init(void);

void hog_send_report(struct bt_conn *conn, uint8_t report);

#ifdef __cplusplus
}
#endif
```
